## board/engicam/icorem6_rqs/Kconfig
```kconfig
if TARGET_ICOREM6_RQS

config SYS_BOARD
	default "icorem6_rqs"

config SYS_VENDOR
	default "engicam"

config SYS_SOC
	default "mx6"

config SYS_CONFIG_NAME
	default "icorem6_rqs"

endif
```

## board/engicam/smarcore_mx6sx/Kconfig
```kconfig
if TARGET_SMARCORE_MX6SX

config SYS_BOARD
	default "smarcore_mx6sx"

config SYS_VENDOR
	default "engicam"

config SYS_SOC
	default "mx6"

config SYS_CONFIG_NAME
	default "smarcore_mx6sx"

endif
```

## configs/geam6ul_emmc_defconfig
```kconfig
# Config for GEA M6UL
# boot from eMMC version
#
CONFIG_SYS_EXTRA_OPTIONS="IMX_CONFIG=board/engicam/geam6ul/imximage.cfg,MX6UL,SYS_MMC_ENV_DEV=1,SYS_BOOT_EMMC"
CONFIG_ARM=y
CONFIG_TARGET_GEAM6UL=y
CONFIG_DM=y
CONFIG_DM_THERMAL=y
```

## configs/geam6ul_mmc_defconfig
```kconfig
# Config for GEA M6UL
# boot from SD card version
#
CONFIG_SYS_EXTRA_OPTIONS="IMX_CONFIG=board/engicam/geam6ul/imximage.cfg,MX6UL,SYS_USE_NAND"
CONFIG_ARM=y
CONFIG_TARGET_GEAM6UL=y
CONFIG_DM=y
CONFIG_DM_THERMAL=y
```

## configs/geam6ul_nand_defconfig
```kconfig
# Config for GEA M6UL
#  boot from NAND version
#
CONFIG_SYS_EXTRA_OPTIONS="IMX_CONFIG=board/engicam/geam6ul/imximage.cfg,MX6UL,SYS_BOOT_NAND,SYS_USE_NAND"
CONFIG_ARM=y
CONFIG_TARGET_GEAM6UL=y
CONFIG_DM=y
CONFIG_DM_THERMAL=y
```

## configs/icore_mx6sx_512_defconfig
```kconfig
CONFIG_SYS_EXTRA_OPTIONS="IMX_CONFIG=board/engicam/icore_mx6sx/imximage.cfg,MX6SX,DDR_MB=512,SYS_BOOT_NAND"
CONFIG_ARM=y
CONFIG_TARGET_ICORE_M6SX=y
CONFIG_DM=y
CONFIG_DM_THERMAL=y
CONFIG_SYS_BOOT_NAND=y
```

## configs/icorem6d2048_mmc_defconfig
```kconfig
CONFIG_SYS_EXTRA_OPTIONS="IMX_CONFIG=board/engicam/icorem6/mx6q.cfg,MX6Q,DDR_MB=512,ENV_IS_IN_MMC"
CONFIG_ARM=y
CONFIG_TARGET_ICOREM6=y
CONFIG_DM=y
CONFIG_DM_THERMAL=y
```

## configs/icorem6dlrqs_emmc_defconfig
```kconfig
CONFIG_SYS_EXTRA_OPTIONS="IMX_CONFIG=board/engicam/icorem6_rqs/mx6dl.cfg,MX6DL,ENV_IS_IN_MMC,SYS_BOOT_EMMC"
CONFIG_ARM=y
CONFIG_TARGET_ICOREM6_RQS=y
CONFIG_DM=y
CONFIG_DM_THERMAL=y
```

## configs/icorem6qd_nand_defconfig
```kconfig
CONFIG_SYS_EXTRA_OPTIONS="IMX_CONFIG=board/engicam/icorem6/icorem6q.cfg,MX6Q,ENV_IS_IN_NAND,SYS_BOOT_NAND"
CONFIG_ARM=y
CONFIG_TARGET_ICOREM6=y
CONFIG_DM=y
CONFIG_DM_THERMAL=y
CONFIG_CMD_MEMTEST=y
```

## configs/icorem6s_mmc_defconfig
```kconfig
CONFIG_SYS_EXTRA_OPTIONS="IMX_CONFIG=board/engicam/icorem6/icorem6dl.cfg,MX6SOLO,ENV_IS_IN_MMC"
CONFIG_ARM=y
CONFIG_TARGET_ICOREM6=y
CONFIG_DM=y
CONFIG_DM_THERMAL=y
CONFIG_CMD_MEMTEST=y
```

## configs/icorem6srqs_emmc_defconfig
```kconfig
CONFIG_SYS_EXTRA_OPTIONS="IMX_CONFIG=board/engicam/icorem6_rqs/mx6solo.cfg,MX6DL,DDR_MB=256,ENV_IS_IN_MMC,SYS_BOOT_EMMC"
CONFIG_ARM=y
CONFIG_TARGET_ICOREM6_RQS=y
CONFIG_DM=y
CONFIG_DM_THERMAL=y
```

## configs/icorem6srqs_mmc_defconfig
```kconfig
CONFIG_SYS_EXTRA_OPTIONS="IMX_CONFIG=board/engicam/icorem6_rqs/mx6solo.cfg,MX6DL,ENV_IS_IN_MMC"
CONFIG_ARM=y
CONFIG_TARGET_ICOREM6_RQS=y
CONFIG_DM=y
CONFIG_DM_THERMAL=y
```

## configs/icorem6sx_mmc_defconfig
```kconfig
CONFIG_SYS_EXTRA_OPTIONS="IMX_CONFIG=board/engicam/icore_mx6sx/imximage.cfg,MX6SX,ENV_IS_IN_MMC"
CONFIG_ARM=y
CONFIG_TARGET_ICORE_MX6SX=y
CONFIG_DM=y
CONFIG_DM_THERMAL=y
```

## configs/icorem6sx_nand_defconfig
```kconfig
CONFIG_SYS_EXTRA_OPTIONS="IMX_CONFIG=board/engicam/icore_mx6sx/imximage.cfg,MX6SX,DDR_MB=256,ENV_IS_IN_NAND,SYS_BOOT_NAND"
CONFIG_ARM=y
CONFIG_TARGET_ICORE_MX6SX=y
CONFIG_DM=y
CONFIG_DM_THERMAL=y
```

## configs/smarcore_mx6sx_2G_defconfig
```kconfig
CONFIG_SYS_EXTRA_OPTIONS="IMX_CONFIG=board/engicam/smarcore_mx6sx/imximage.cfg,MX6SX,DDR_MB=2048,MX6SX,SYS_BOOT_NAND"
CONFIG_ARM=y
CONFIG_TARGET_ICORE_M6SX=y
CONFIG_DM=y
CONFIG_DM_THERMAL=y
CONFIG_SYS_BOOT_NAND=y
```

## configs/smarcorem6sx_mmc_defconfig
```kconfig
CONFIG_SYS_EXTRA_OPTIONS="IMX_CONFIG=board/engicam/smarcore_mx6sx/imximage.cfg,MX6SX,DDR_MB=512,ENV_IS_IN_MMC"
CONFIG_ARM=y
CONFIG_TARGET_SMARCORE_MX6SX=y
CONFIG_DM=y
CONFIG_DM_THERMAL=y
```
